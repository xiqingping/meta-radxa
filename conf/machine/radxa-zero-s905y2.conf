## conf/machine/radxa-zero-s905y2.conf
```bitbake
#@TYPE: Machine
#@NAME: Radxa Zero machine
#@DESCRIPTION: Radxa Zero config file

SOC_FAMILY = "s905y2"

include conf/machine/include/tune-cortexa53.inc
require conf/machine/include/soc-family.inc

PREFERRED_PROVIDER_virtual/kernel ?= "linux-radxa-zero"
PREFERRED_VERSION_linux-rockchip = "5.10"
KBUILD_DEFCONFIG = "radxa_zero_defconfig"
KERNEL_IMAGETYPE = "Image"

SERIAL_CONSOLES = "115200;ttyAML0"

PREFERRED_PROVIDER_virtual/bootloader ?= "u-boot-radxa-zero"
KERNEL_DEVICETREE = "amlogic/meson-g12a-radxa-zero.dtb"
UBOOT_MACHINE = "radxa-zero_defconfig"
```

## conf/machine/rock-3a-rk3568.conf
```bitbake
#@TYPE: Machine
#@NAME: Rock-3a machine
#@DESCRIPTION: Rock-3a development board config file

require conf/machine/include/rock-3a-rk3568.inc

KERNEL_DEVICETREE = "rockchip/rk3568-rock-3a.dtb"
UBOOT_MACHINE = "rock-3a-rk3568_defconfig"
```
